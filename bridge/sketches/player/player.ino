// Player for song headers generated by the MIDI converter.
// Expects song.h in the same sketch folder with voice1[]..voice4[] in PROGMEM
// (as written by dashboard/src/exporter_arduino.py).
//
// Pin mapping (CNC Shield V3 / UNO):
//   voice1 -> X  STEP=2  DIR=5   (melody)
//   voice2 -> Y  STEP=3  DIR=6   (Bass)
//   voice3 -> Z  STEP=4  DIR=7   (upper harmony)
//   voice4 -> A  STEP=12 DIR=13  (lower harmony, native 4th axis path,
//                                 jumper caps on the D12/D13 selector)
//   EN = D8 (LOW = enabled)

#include <Arduino.h>
#include <avr/pgmspace.h>
#include "song.h"

struct StepperVoice {
  uint8_t  stepPin;
  uint8_t  dirPin;
  const NoteEvent* sequence;
  uint16_t sequenceLength;
  uint16_t noteIndex;
  unsigned long noteEndMillis;
  unsigned long halfPeriodMicros;
  unsigned long nextToggleMicros;
  bool     stepState;
  bool     finished;
};

const uint8_t EN_PIN = 8;
const uint8_t NUM_VOICES = 4;
StepperVoice voices[NUM_VOICES];

// ─── Sync tick (A/V clapper) ─────────────────────────────────────────────
// On "TICK\n" during the GO-wait, all four motors do one short audible
// burst together. Recorded in both the audio take and the video take, it
// is the single physical event used to align the two recordings.
const unsigned long GO_WAIT_TIMEOUT_MS = 20000;  // standalone fail-safe only
const uint16_t TICK_STEPS    = 28;    // ~length of the click
const uint16_t TICK_HALF_US  = 900;   // half-period → ~555 Hz blip

void doSyncTick() {
  digitalWrite(EN_PIN, LOW);          // enable drivers for the burst
  delayMicroseconds(80);              // let A4988 current settle
  for (uint16_t s = 0; s < TICK_STEPS; s++) {
    for (uint8_t i = 0; i < NUM_VOICES; i++) digitalWrite(voices[i].stepPin, HIGH);
    delayMicroseconds(TICK_HALF_US);
    for (uint8_t i = 0; i < NUM_VOICES; i++) digitalWrite(voices[i].stepPin, LOW);
    delayMicroseconds(TICK_HALF_US);
  }
  digitalWrite(EN_PIN, HIGH);         // disabled again — silent until GO
}

static void loadNote(const NoteEvent* seq, uint16_t idx, NoteEvent& out) {
  memcpy_P(&out, &seq[idx], sizeof(NoteEvent));
}

void initVoice(StepperVoice& v, uint8_t stepPin, uint8_t dirPin,
               const NoteEvent* seq, uint16_t seqLen) {
  v.stepPin = stepPin;
  v.dirPin  = dirPin;
  v.sequence = seq;
  v.sequenceLength = seqLen;
  v.noteIndex = 0;
  v.noteEndMillis = 0;
  v.halfPeriodMicros = 0;
  v.nextToggleMicros = 0;
  v.stepState = false;
  v.finished = (seqLen == 0);

  pinMode(stepPin, OUTPUT);
  pinMode(dirPin, OUTPUT);
  digitalWrite(stepPin, LOW);
  digitalWrite(dirPin, LOW);
}

void startNote(StepperVoice& v, const NoteEvent& note) {
  if (note.frequency <= 0.0f) {
    v.halfPeriodMicros = 0;
    digitalWrite(v.stepPin, LOW);
    v.stepState = false;
  } else {
    v.halfPeriodMicros = (unsigned long)(500000.0f / note.frequency);
    v.nextToggleMicros = micros() + v.halfPeriodMicros;
  }
  v.noteEndMillis = millis() + note.durationMs;
}

void advanceVoice(StepperVoice& v) {
  v.noteIndex++;
  if (v.noteIndex >= v.sequenceLength) {
    v.finished = true;
    v.halfPeriodMicros = 0;
    digitalWrite(v.stepPin, LOW);
    return;
  }
  NoteEvent n;
  loadNote(v.sequence, v.noteIndex, n);
  startNote(v, n);
}

void updateVoice(StepperVoice& v) {
  if (v.finished) return;

  if ((long)(millis() - v.noteEndMillis) >= 0) {
    advanceVoice(v);
    if (v.finished) return;
  }

  if (v.halfPeriodMicros == 0) return;

  unsigned long now = micros();
  if ((long)(now - v.nextToggleMicros) >= 0) {
    v.stepState = !v.stepState;
    digitalWrite(v.stepPin, v.stepState ? HIGH : LOW);
    v.nextToggleMicros += v.halfPeriodMicros;
  }
}

void setup() {
  Serial.begin(115200);

  pinMode(EN_PIN, OUTPUT);
  digitalWrite(EN_PIN, HIGH);  // motors disabled while waiting for GO

  initVoice(voices[0], 2,  5,  voice1, voice1Length);
  initVoice(voices[1], 3,  6,  voice2, voice2Length);
  initVoice(voices[2], 4,  7,  voice3, voice3Length);
  initVoice(voices[3], 12, 13, voice4, voice4Length);

  Serial.println(F("=== player ready ==="));

  // Wait for "GO\n" from the PC bridge before starting the first notes.
  // The bridge sends GO once the LED sync side is warmed up (incl. the
  // pre-roll), so the wall and the steppers begin in lockstep. A "TICK\n"
  // received before GO fires the A/V sync clapper and keeps waiting. The
  // timeout is a fail-safe for standalone use (no bridge): auto-start.
  char buf[8];
  uint8_t blen = 0;
  unsigned long deadline = millis() + GO_WAIT_TIMEOUT_MS;
  while (millis() < deadline) {
    if (Serial.available()) {
      char c = (char)Serial.read();
      if (c == '\n' || c == '\r') {
        if (blen == 2 && buf[0] == 'G' && buf[1] == 'O') break;
        if (blen == 4 && buf[0] == 'T' && buf[1] == 'I'
                      && buf[2] == 'C' && buf[3] == 'K') {
          doSyncTick();
        }
        blen = 0;
      } else if (blen < sizeof(buf) - 1) {
        buf[blen++] = c;
      } else {
        blen = 0;
      }
    }
  }

  digitalWrite(EN_PIN, LOW);  // enable motors
  for (uint8_t i = 0; i < NUM_VOICES; i++) {
    if (voices[i].sequenceLength == 0) continue;
    NoteEvent n;
    loadNote(voices[i].sequence, 0, n);
    startNote(voices[i], n);
  }

  Serial.println(F("=== player start ==="));
}

void loop() {
  static bool allDone = false;
  if (allDone) return;

  bool anyActive = false;
  for (uint8_t i = 0; i < NUM_VOICES; i++) {
    updateVoice(voices[i]);
    if (!voices[i].finished) anyActive = true;
  }

  if (!anyActive) {
    digitalWrite(EN_PIN, HIGH);
    Serial.println(F("=== player done ==="));
    allDone = true;
  }
}
